## components/osh_node/Kconfig.projbuild
```kconfig
menu "Open Smart Home Node config"

menuconfig NODE_ENABLE_RESET
    bool "Enable reset button"
    default y
    if NODE_ENABLE_RESET
        config NODE_RESET_GPIO_NUM
            int "GPIO number to reset node"
            range 0 39
            default 19 if IDF_TARGET_ESP32C3
            default 22 if IDF_TARGET_ESP32
    endif

config NODE_WIFI_PROV_RETRIES
    int "retry number for WiFi Provisioning"
    default 10

config NODE_WIFI_CHECK_PERIOD
    int "period in seconds to check the network"
    default 1800

menu "Proto Server"
    choice NODE_PROTO_SECURE_MODE
        prompt "Secure mode of protocol"
        config NODE_PROTO_SECURE_NONE
            bool "None"
            default n
        config NODE_PROTO_MBEDTLS_PKI
            bool "PKI Certificates"
            default y
    endchoice
    config NODE_PROTO_PORT
        int "UDP server listen port"
        default 39099
    config NODE_PROTO_REPORT_ADDR
        string "Proto Multicast IPV4 Address for Report (send)"
        default "239.0.0.199"
        help
            IPV4 broadcast address to send report like heartbeat.

            The default broadcast IPV4 address is 224.0.0.99.
    config NODE_PROTO_REPORT_PORT
        int "Proto Multicast port for Report (send)"
        default 39099
    config NODE_PROTO_MDM_ADDR
        string "Proto Multicast IPV4 Address for MDM (receive)"
        default "239.0.0.188"
        help
            IPV4 multicast address to receive MDM command.

            The default CoAP IPV4 address is 224.0.0.188.
    config NODE_PROTO_MDM_PORT
        int "Proto Multicast port for MDM (receive)"
        default 39098
    config NODE_PROTO_BUFF_SIZE
        int "buffer size of proto protocol"
        default 512
    config NODE_PROTO_HB_PERIOD
        int "period in second for heartbeat broadcast"
        default 60
endmenu

menu "Status RGB LED"
    config STATUS_R_LED_GPIO_NUM
        int "GPIO number for status RED LED"
        range 0 33
        default 3 if IDF_TARGET_ESP32C3
        default 12 if IDF_TARGET_ESP32
    config STATUS_G_LED_GPIO_NUM
        int "GPIO number for status GREEN LED"
        range 0 33
        default 5 if IDF_TARGET_ESP32C3
        default 13 if IDF_TARGET_ESP32
    config STATUS_B_LED_GPIO_NUM
        int "GPIO number for status BLUE LED"
        range 0 33
        default 6 if IDF_TARGET_ESP32C3
        default 14 if IDF_TARGET_ESP32
endmenu

endmenu
```
